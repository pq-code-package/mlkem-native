/*
 * Copyright (c) The mlkem-native project authors
 * SPDX-License-Identifier: Apache-2.0 OR ISC OR MIT
 */

/*
 * WARNING: This file is auto-generated from scripts/autogen
 *          in the mlkem-native repository.
 *          Do not modify it directly.
 */


/*
 * Table of zeta values used in the reference NTT and inverse NTT.
 * Each row is (zeta_mont, zeta_twisted); see autogen for details.
 */
static MLK_ALIGN const int16_t mlk_zetas[128][2] = {
    {-1044, -20},    {-758, 31498},   {-359, 14745},   {-1517, 787},
    {1493, 13525},   {1422, -12402},  {287, 28191},    {202, -16694},
    {-171, -20907},  {622, 27758},    {1577, -3799},   {182, -15690},
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    {958, 23998},    {-1460, 7756},   {1522, -17422},  {1628, 23132},
};
