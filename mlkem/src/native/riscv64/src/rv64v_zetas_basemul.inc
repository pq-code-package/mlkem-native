/*
 * Copyright (c) The mlkem-native project authors
 * SPDX-License-Identifier: Apache-2.0 OR ISC OR MIT
 */

/*
 * WARNING: This file is auto-generated from scripts/autogen
 *          in the mlkem-native repository.
 *          Do not modify it directly.
 */

#include <stdint.h>
#include "arith_native_riscv64.h"

const int16_t roots[] = {
    -1103, 1103,  430,   -430,  555,   -555,  843,   -843,  -1251, 1251,  871,
    -871,  1550,  -1550, 105,   -105,  422,   -422,  587,   -587,  177,   -177,
    -235,  235,   -291,  291,   -460,  460,   1574,  -1574, 1653,  -1653, -246,
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    -958,  -1460, 1460,  1522,  -1522, 1628,  -1628,
};
