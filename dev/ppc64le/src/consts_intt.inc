/*
 * Copyright (c) The mlkem-native project authors
 * SPDX-License-Identifier: Apache-2.0 OR ISC OR MIT
 */

    /*
     * For intt Len=2, offset IZETA_NTT_OFFSET127
     * reorder zeta array, (1, 2, 3, 4) -> (3, 1, 4, 2)
     * Transpose z[0], z[1], z[2], z[3]
     *    -> z[3], z[3], z[1], z[1], z[4], z[4], z[2], z[2]
     */
    -1460, -1460, 1628, 1628, 958, 958, 1522, 1522, -308, -308, 991, 991, -108,
    -108, 996, 996, -854, -854, 478, 478, -1510, -1510, -870, -870, -1530,
    -1530, 794, 794, -1185, -1185, -1278, -1278, 220, 220, -1659, -1659, -874,
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    105, -1251, -1251, 1550, 1550, 430, 430, 843, 843, -1103, -1103, 555, 555,
    /* For intt Len=4 */
    677, 677, 677, 677, -1275, -1275, -1275, -1275,
    448, 448, 448, 448, -1065, -1065, -1065, -1065,
    -1508, -1508, -1508, -1508, -725, -725, -725, -725,
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    1223, 1223, 1223, 1223, 652, 652, 652, 652,
    /* For intt Len=8 and others */
    -1571, -1571, -1571, -1571, -1571, -1571, -1571, -1571, -205, -205, -205,
    -205, -205, -205, -205, -205, 411, 411, 411, 411, 411, 411, 411, 411, -1542,
    -1542, -1542, -1542, -1542, -1542, -1542, -1542, 608, 608, 608, 608, 608,
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    -758, -758, -758, -758, -758, -758
